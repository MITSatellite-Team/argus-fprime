## boards/argus/Kconfig.argus
```kconfig
# Based on Zephyr's rpi_pico2 board
# Copyright (c) 2024 Andrew Featherstone
# Copyright (c) 2025 Magpie Embedded
# SPDX-License-Identifier: Apache-2.0

config BOARD_ARGUS
	select SOC_RP2350B_M33 if BOARD_ARGUS_RP2350B_M33
```

## boards/argus/Kconfig.defconfig
```kconfig
# Based on Zephyr's rpi_pico2 board
# Copyright (c) 2024 Andrew Featherstone
# SPDX-License-Identifier: Apache-2.0

if BOARD_ARGUS

config USB_SELF_POWERED
	default n

endif # BOARD_ARGUS
```
